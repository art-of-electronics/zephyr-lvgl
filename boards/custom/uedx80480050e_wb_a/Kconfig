## boards/custom/uedx80480050e_wb_a/Kconfig
```kconfig
# SPDX-License-Identifier: Apache-2.0

config HEAP_MEM_POOL_ADD_SIZE_BOARD
	int
	default 4096 if BOARD_UEDX80480050E_WB_A_ESP32S3_PROCPU
	default 256 if BOARD_UEDX80480050E_WB_A_ESP32S3_APPCPU

config ESP32_LCD_RGB_FRAMEBUFFER_COUNT
    int "Number of LCD RGB framebuffers"
    range 1 3
    default 2
    help
      Select the number of PSRAM framebuffers.

      One framebuffer reduces memory usage but may cause tearing.
      Two framebuffers enable synchronized, tear-free presentation.
      Three framebuffers allow rendering the next frame while a
      completed frame is waiting for presentation, potentially
      reducing rendering stalls at the cost of additional memory.

configdefault ESP_SPIRAM_HEAP_SIZE
    default 1048576 if ESP32_LCD_RGB_FRAMEBUFFER_COUNT = 1
    default 2097152 if ESP32_LCD_RGB_FRAMEBUFFER_COUNT = 2
    default 3145728 if ESP32_LCD_RGB_FRAMEBUFFER_COUNT = 3

config LOG_LCD_CAM_DIAGNOSTICS
    bool "Enable LCD_CAM RGB driver diagnostics"
    default n
    depends on LOG
    help
      Enable performance measurements and periodic diagnostic logging
      for the ESP32-S3 LCD_CAM RGB display driver.
```

## boards/custom/uedx80480050e_wb_a/Kconfig.defconfig
```kconfig
# SPDX-License-Identifier: Apache-2.0

if BOARD_UEDX80480050E_WB_A_ESP32S3_PROCPU

config ESP_SPIRAM
	default y

choice SPIRAM_MODE
	default SPIRAM_MODE_OCT
endchoice

if DISPLAY

if LVGL

configdefault LV_COLOR_16_SWAP
	default y

config LV_Z_VDB_SIZE
	default 100

config LV_Z_VDB_CUSTOM_SECTION
	default y

config LV_Z_MEMORY_POOL_CUSTOM_SECTION
	default y

endif # LVGL

config REGULATOR
	default y

endif # DISPLAY

configdefault INPUT_GT911_INTERRUPT
    default y if GT911_TOUCHSCREEN_INT

configdefault INPUT_GT911_PERIOD_MS
    default 10 if GT911_TOUCHSCREEN_POLL

endif # BOARD_UEDX80480050E_WB_A_ESP32S3_PROCPU
```

## boards/custom/uedx80480050e_wb_a/board.yml
```yaml
board:
  name: uedx80480050e_wb_a
  full_name: VIEWE UEDX80480050E-WB-A
  vendor: viewe
  revision:
    format: major.minor
    default: "1.2"
    exact: true
    revisions:
      - name: "1.2"
  socs:
    - name: esp32s3
```

## boards/cyd/esp32_035/Kconfig
```kconfig
config HEAP_MEM_POOL_ADD_SIZE_BOARD
    int
    default 4096 if BOARD_ESP32_035_ESP32_PROCPU

choice CYD_LCD_ROTATION
    prompt "CYD LCD orientation (fixed at boot)"
    default CYD_LCD_ROTATION_0
    help
      Select the ST7796S display orientation at build time.
      Touchscreen orientation follows the LCD configuration.

config CYD_LCD_ROTATION_0
    bool "0 degrees (portrait)"

config CYD_LCD_ROTATION_90
    bool "90 degrees clockwise (landscape)"

config CYD_LCD_ROTATION_180
    bool "180 degrees (portrait)"

config CYD_LCD_ROTATION_270
    bool "270 degrees clockwise (landscape)"

endchoice
```

## boards/cyd/esp32_035/Kconfig.esp32_035
```kconfig
# SPDX-License-Identifier: Apache-2.0

config BOARD_ESP32_035
	select SOC_ESP32
	select SOC_ESP32_PROCPU if BOARD_ESP32_035_ESP32_PROCPU
```

## boards/cyd/esp32_035/board.yml
```yaml
board:
  name: esp32_035
  full_name: CYD ESP32-035
  vendor: cyd
  socs:
    - name: esp32
```

## boards/viewe/uedx48270043e_wb_a/board.yml
```yaml
board:
  name: uedx48270043e_wb_a
  full_name: VIEWE UEDX48270043E-WB-A
  vendor: viewe
  revision:
    format: major.minor.patch
    default: "1.3.0"
    exact: true
    revisions:
      - name: "1.3.0"
  socs:
    - name: esp32s3
```

## boards/viewe/uedx80480050e_wb_a/Kconfig
```kconfig
# SPDX-License-Identifier: Apache-2.0

config HEAP_MEM_POOL_ADD_SIZE_BOARD
	int
	default 4096 if BOARD_UEDX80480050E_WB_A_ESP32S3_PROCPU
	default 256 if BOARD_UEDX80480050E_WB_A_ESP32S3_APPCPU

config ESP32_LCD_RGB_FRAMEBUFFER_COUNT
    int "Number of LCD RGB framebuffers"
    range 1 3
    default 2
    help
      Select the number of PSRAM framebuffers.

      One framebuffer reduces memory usage but may cause tearing.
      Two framebuffers enable synchronized, tear-free presentation.
      Three framebuffers allow rendering the next frame while a
      completed frame is waiting for presentation, potentially
      reducing rendering stalls at the cost of additional memory.

configdefault ESP_SPIRAM_HEAP_SIZE
    default 1048576 if ESP32_LCD_RGB_FRAMEBUFFER_COUNT = 1
    default 2097152 if ESP32_LCD_RGB_FRAMEBUFFER_COUNT = 2
    default 3145728 if ESP32_LCD_RGB_FRAMEBUFFER_COUNT = 3

config LOG_LCD_CAM_DIAGNOSTICS
    bool "Enable LCD_CAM RGB driver diagnostics"
    default n
    depends on LOG
    help
      Enable performance measurements and periodic diagnostic logging
      for the ESP32-S3 LCD_CAM RGB display driver.

choice GT911_TOUCHSCREEN_MODE
    prompt "GT911 touchscreen mode"
    depends on INPUT_GT911
    default GT911_TOUCHSCREEN_POLL

config GT911_TOUCHSCREEN_POLL
    bool "Polling (R33 not mounted)"

config GT911_TOUCHSCREEN_INT
    bool "Interrupt (R33 mounted)"

endchoice

choice ESP32_LCD_RGB_ROTATION
    prompt "LCD RGB orientation (fixed at boot)"
    default ESP32_LCD_RGB_ROTATION_0
    help
      Select the display orientation at build time.
      LCD_CAM scanout always uses the physical panel resolution.

config ESP32_LCD_RGB_ROTATION_0
    bool "0 degrees"

config ESP32_LCD_RGB_ROTATION_180
    bool "180 degrees"

endchoice
```

## boards/viewe/uedx80480050e_wb_a/board.yml
```yaml
board:
  name: uedx80480050e_wb_a
  full_name: VIEWE UEDX80480050E-WB-A
  vendor: viewe
  revision:
    format: major.minor.patch
    default: "1.2.0"
    exact: true
    revisions:
      - name: "1.2.0"
  socs:
    - name: esp32s3
```

## drivers/display/cyd_st7796s/Kconfig
```kconfig
config CYD_ST7796S_PANEL_INIT
    bool "CYD ST7796S panel initialization"
    depends on ST7796S
    help
      Enable CYD-specific ST7796S panel configuration
      using the existing Zephyr MIPI DBI interface.
```

## drivers/display/esp32_lcd_cam_rgb/Kconfig
```kconfig
config ESP32_LCD_CAM_RGB
    bool "ESP32-S3 LCD_CAM RGB display driver"
    default y if DT_HAS_ESPRESSIF_ESP32_LCD_CAM_RGB_ENABLED
    depends on DISPLAY
    depends on SOC_SERIES_ESP32S3
    depends on DMA
    depends on PINCTRL
    help
      Enable the RGB display driver using the ESP32-S3
      LCD_CAM peripheral and GDMA.
```

## dts/bindings/display/espressif,esp32-lcd-cam-rgb.yaml
```yaml
# SPDX-License-Identifier: Apache-2.0

description: |
  ESP32-S3 LCD_CAM RGB display controller.

  Provides a 16-bit RGB565 parallel display interface
  using the LCD_CAM peripheral and GDMA.

compatible: "espressif,esp32-lcd-cam-rgb"

include: display-controller.yaml
```
