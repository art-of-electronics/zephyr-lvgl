## CMakeLists.txt
```
cmake_minimum_required(VERSION 3.20.0)

set(DTC_OVERLAY_FILE "${CMAKE_CURRENT_SOURCE_DIR}/backlight.overlay")

find_package(Zephyr REQUIRED HINTS $ENV{ZEPHYR_BASE})
project(stm32h7b3i_demo)

target_include_directories(app PRIVATE
    ${CMAKE_CURRENT_SOURCE_DIR}/include
)

target_sources(app PRIVATE 
    src/main.c
    src/backlight.c
    src/display.c
    src/performance.c
    src/morph_ball.c
    assets/morph_ball.c
)
```

## prj.conf
```kconfig
# System
CONFIG_MAIN_STACK_SIZE=8192

# Logg
CONFIG_LOG=y
CONFIG_LV_USE_LOG=y

# Display
CONFIG_DISPLAY=y
CONFIG_DISPLAY_LOG_LEVEL_ERR=y

# Touchscreen
CONFIG_INPUT=y

# LVGL
CONFIG_LVGL=y
CONFIG_LV_Z_PARTIAL_REFRESH=y
CONFIG_LV_Z_VDB_SIZE=25
CONFIG_LV_Z_MEM_POOL_SIZE=16384
CONFIG_LV_DEF_REFR_PERIOD=16

CONFIG_LV_USE_LABEL=y

# LVGL fonts
CONFIG_LV_FONT_MONTSERRAT_14=y
CONFIG_LV_FONT_MONTSERRAT_40=y

# GPIO
CONFIG_PWM=y
```

## src/main.c
```c
/*****************************************************************************
                                    INCLUDES
*****************************************************************************/
#include <zephyr/kernel.h>
#include <zephyr/logging/log.h>

#include <lvgl.h>

#include <display.h>
#include <backlight.h>
#include <performance.h>
#include <theme.h>

#include <morph_ball.h>


/*****************************************************************************
                          PRIVATE DEFINES / MACROS
*****************************************************************************/
LOG_MODULE_REGISTER(app_main, LOG_LEVEL_INF);

#define MAIN_LOOP_PERIOD_MS (2U)
#define PERF_PRINT_REPORT   (true)
#define ENABLE_BTN_ANIM     (false)


/*****************************************************************************
                     PRIVATE STRUCTS / ENUMS / VARIABLES
*****************************************************************************/

/*****************************************************************************
                         PRIVATE FUNCTION DECLARATIONS
*****************************************************************************/

/*****************************************************************************
                       PRIVATE FUNCTION IMPLEMENTATIONS
*****************************************************************************/

/*****************************************************************************
                           INTERFACE IMPLEMENTATION
*****************************************************************************/
int main(void)
{
    int ret = 0;

    ret = app_display_init(lv_color_hex(CHOZO_DARK_BLUE));
    if (0 != ret) {
        LOG_ERR("Display initialization failed: %d", ret);
        return 0;
    }

    (void)lv_timer_handler();

    ret = app_display_enable();
    if (0 != ret) {
        LOG_ERR("Failed to enable display: %d", ret);
        return 0;
    }

    backlight_btn_t colors = {
        .background = lv_color_hex(CHOZO_DARK_BLUE),
        .icon = lv_color_hex(SAMUS_YELLOW),
        .border = lv_color_hex(SAMUS_VARIA_ORANGE),
    };
    backlight_button_create(lv_screen_active(), colors, ENABLE_BTN_ANIM);

    app_display_create_version_label(lv_screen_active(), lv_color_hex(SAMUS_VARIA_ORANGE));
    
    ret = performance_init(lv_screen_active(), PERF_PRINT_REPORT);
    if (0 != ret) {
        LOG_ERR("Performance initialization failed: %d", ret);
        return 0;
    }

    ret = morph_ball_init(lv_screen_active());
    if (0 != ret) {
        LOG_ERR("Demo initialization failed: %d", ret);
        return 0;
    }

    ret = morph_ball_run();
    if (0 != ret) {
        LOG_ERR("Demo start failed: %d", ret);
        return 0;
    }

    while (true) {
        uint32_t start_cycles = 0U;
        uint32_t elapsed_cycles = 0U;

        performance_report();

        start_cycles = k_cycle_get_32();

        (void)lv_timer_handler();

        elapsed_cycles = k_cycle_get_32() - start_cycles;

        performance_record_lvgl_handler(elapsed_cycles);

        k_sleep(K_MSEC(MAIN_LOOP_PERIOD_MS));
    }
}
```

## include/morph_ball.h
```c
/**
 * @file morph_ball.h
 * @brief Morph Ball graphical demo initialization and animation.
 *
 * Provides functions for creating the Morph Ball graphical
 * interface and starting its animation.
 */

#ifndef MORPH_BALL_H
#define MORPH_BALL_H

/*****************************************************************************
                                    INCLUDES
*****************************************************************************/
#include <lvgl.h>


/*****************************************************************************
                       PUBLIC DEFINES / MACROS / ENUMS
*****************************************************************************/

/*****************************************************************************
                         PUBLIC INTERFACE DECLARATION
*****************************************************************************/
/**
 * @brief Initialize the Morph Ball demo.
 * @param [in] screen Pointer to the LVGL screen.
 * @return 0 on success, negative errno on failure.
 */
int morph_ball_init(lv_obj_t *screen);

/**
 * @brief Start the Morph Ball animation.
 * @return 0 on success, negative errno on failure.
 */
int morph_ball_run(void);

#endif // MORPH_BALL_H
```

## src/backlight.c
```c
/*****************************************************************************
                                    INCLUDES
*****************************************************************************/
#include <backlight.h>

#include <zephyr/device.h>
#include <zephyr/devicetree.h>
#include <zephyr/drivers/pwm.h>
#include <zephyr/kernel.h>
#include <zephyr/logging/log.h>


/*****************************************************************************
                          PRIVATE DEFINES / MACROS
*****************************************************************************/
LOG_MODULE_REGISTER(backlight, LOG_LEVEL_INF);

#define BACKLIGHT_NODE DT_NODELABEL(lcd_backlight)
#define BACKLIGHT_LOW_PERCENT   (35U)
#define BACKLIGHT_HIGH_PERCENT  (85U)
#define BACKLIGHT_PERCENT_MAX   (100U)


/*****************************************************************************
                     PRIVATE STRUCTS / ENUMS / VARIABLES
*****************************************************************************/
static bool backlight_high = true;
static lv_obj_t *backlight_button = NULL;
static lv_obj_t *backlight_icon = NULL;

static const struct pwm_dt_spec backlight = PWM_DT_SPEC_GET(BACKLIGHT_NODE);


/*****************************************************************************
                         PRIVATE FUNCTION DECLARATIONS
*****************************************************************************/

/*****************************************************************************
                       PRIVATE FUNCTION IMPLEMENTATIONS
*****************************************************************************/
static void backlight_button_cb(lv_event_t *event)
{
    int ret = 0;
    uint32_t brightness = BACKLIGHT_LOW_PERCENT;

    ARG_UNUSED(event);

    brightness = (true == backlight_high) ? (BACKLIGHT_LOW_PERCENT) : (BACKLIGHT_HIGH_PERCENT);
    ret = backlight_set_brightness(brightness);
    if (0 != ret) {
        LOG_ERR("Backlight PWM error: %d", ret);
        return;
    }

    backlight_high = !backlight_high;
    lv_label_set_text(backlight_icon, (true == backlight_high) ? (LV_SYMBOL_EYE_OPEN) : (LV_SYMBOL_EYE_CLOSE));
}


/*****************************************************************************
                           INTERFACE IMPLEMENTATION
*****************************************************************************/
void backlight_button_create(lv_obj_t *screen, backlight_btn_t colors, bool enable_anim)
{
    backlight_button = lv_button_create(screen);

    if (true != enable_anim) {
        lv_obj_remove_style_all(backlight_button);
    }

    lv_obj_set_size(backlight_button, 42, 42);
    lv_obj_align(backlight_button, LV_ALIGN_TOP_LEFT, 8, 8);
    lv_obj_set_style_radius(backlight_button, LV_RADIUS_CIRCLE, 0);
    lv_obj_set_style_bg_color(backlight_button, colors.background, 0);
    lv_obj_set_style_bg_opa(backlight_button, LV_OPA_COVER, 0);

    lv_obj_set_style_border_width(backlight_button, 2, 0);
    lv_obj_set_style_border_color(backlight_button, colors.border, 0);

    lv_obj_add_event_cb(backlight_button, backlight_button_cb, LV_EVENT_CLICKED, NULL);

    backlight_icon = lv_label_create(backlight_button);
    lv_label_set_text(backlight_icon, LV_SYMBOL_EYE_OPEN);
    lv_obj_center(backlight_icon);
    lv_obj_set_style_text_color(backlight_icon, colors.icon, 0);
}

int backlight_init(void) 
{
    int ret = 0;

    if (true != pwm_is_ready_dt(&backlight)) {
        LOG_ERR("Backlight PWM device not ready");
        return -ENODEV;
    }

    ret = backlight_set_brightness(BACKLIGHT_HIGH_PERCENT);
    if (0 != ret) {
        LOG_ERR("Backlight PWM error: %d", ret);
    }

    return ret;
}

int backlight_set_brightness(uint32_t percent)
{
    uint32_t pulse_ns = 0U;

    if (BACKLIGHT_PERCENT_MAX < percent) {
        return -EINVAL;
    }

    pulse_ns = (uint32_t)(((uint64_t)backlight.period * percent) / BACKLIGHT_PERCENT_MAX);
    return pwm_set_dt(&backlight, backlight.period, pulse_ns);
}

uint32_t backlight_get_brightness(void)
{
    return (true == backlight_high) ? (BACKLIGHT_HIGH_PERCENT) : (BACKLIGHT_LOW_PERCENT);
}
```

## src/display.c
```c
/*****************************************************************************
                                    INCLUDES
*****************************************************************************/
#include <errno.h>
#include <stdio.h>

#include <zephyr/device.h>
#include <zephyr/devicetree.h>
#include <zephyr/drivers/display.h>
#include <zephyr/logging/log.h>
#include <zephyr/version.h>

#include <backlight.h>
#include <display.h>
#include <theme.h>


/*****************************************************************************
                          PRIVATE DEFINES / MACROS
*****************************************************************************/
LOG_MODULE_REGISTER(app_display, LOG_LEVEL_INF);

#define VERSION_TEXT_SIZE   (64U)
#define VERSION_LABEL_Y_POS (12)


/*****************************************************************************
                     PRIVATE STRUCTS / ENUMS / VARIABLES
*****************************************************************************/
static const struct device *display_dev = DEVICE_DT_GET(DT_CHOSEN(zephyr_display));


/*****************************************************************************
                         PRIVATE FUNCTION DECLARATIONS
*****************************************************************************/

/*****************************************************************************
                       PRIVATE FUNCTION IMPLEMENTATIONS
*****************************************************************************/

/*****************************************************************************
                           INTERFACE IMPLEMENTATION
*****************************************************************************/
int app_display_init(lv_color_t color_bg)
{
    lv_display_t *display = NULL;
    lv_obj_t *screen = NULL;

    if (false == device_is_ready(display_dev)) {
        LOG_ERR("Display device not ready");
        return -ENODEV;
    }

    display = lv_display_get_default();
    if (NULL == display) {
        LOG_ERR("No LVGL display");
        return -ENODEV;
    }

    screen = lv_screen_active();
    if (NULL == screen) {
        LOG_ERR("No active LVGL screen");
        return -ENODEV;
    }

    lv_obj_set_style_bg_color(screen, color_bg, LV_PART_MAIN);
    lv_obj_set_style_bg_opa(screen, LV_OPA_COVER, LV_PART_MAIN);

    lv_obj_set_scrollable(screen, false);

    return 0;
}

int app_display_enable(void)
{
    int ret = 0;

    ret = display_blanking_off(display_dev);
    if ((0 > ret) && (-ENOSYS != ret)) {
        LOG_ERR("Failed to disable display blanking: %d", ret);
        return ret;
    }

    ret = backlight_init();
    if (0 != ret) {
        LOG_WRN("Backlight initialization failed: %d", ret);
    }

    return 0;
}

void app_display_create_version_label(lv_obj_t *screen, lv_color_t text_color)
{
    if (NULL == screen) {
        return;
    }

    lv_obj_t *version_label = NULL;
    char version_text[VERSION_TEXT_SIZE] = {0};

    (void)snprintf(version_text, sizeof(version_text),
                   "Zephyr %u.%u x LVGL %u.%u",
                   (unsigned int)KERNEL_VERSION_MAJOR, (unsigned int)KERNEL_VERSION_MINOR,
                   (unsigned int)lv_version_major(), (unsigned int)lv_version_minor());
    version_label = lv_label_create(screen);
    if (NULL == version_label) {
        LOG_ERR("Failed to create version label");
        return;
    }

    lv_label_set_text(version_label, version_text);
	lv_obj_set_style_text_font(version_label, &lv_font_montserrat_40, LV_PART_MAIN);
	lv_obj_set_style_text_color(version_label, text_color, LV_PART_MAIN);
	lv_obj_set_style_text_align(version_label, LV_TEXT_ALIGN_CENTER, LV_PART_MAIN);
	lv_obj_center(version_label);
}
```

## src/morph_ball.c
```c
/*****************************************************************************
                                    INCLUDES
*****************************************************************************/
#include <errno.h>

#include <zephyr/kernel.h>
#include <zephyr/logging/log.h>

#include <morph_ball.h>
#include <performance.h>
#include <theme.h>


/*****************************************************************************
                          PRIVATE DEFINES / MACROS
*****************************************************************************/
LOG_MODULE_REGISTER(morph_ball, LOG_LEVEL_INF);

#define PI_APPROX_MILLI (3142U)
#define MILLI_SCALE     (1000U)
#define MAX_DELTA_MS    (100U)

#define TIMER_PERIOD_MS (16U)
#define ANGLE_FULL_TURN (3600U)

#define FLOOR_OFFSET_PX (34U)
#define FLOOR_HEIGHT_PX (3U)
#define BALL_SIZE_PX    (64U)
#define BALL_RADIUS_PX  ((BALL_SIZE_PX) / 2U)
#define BALL_CIRCUMFERENCE_MILLI (2U * BALL_RADIUS_PX * PI_APPROX_MILLI)

#define BALL_SPEED_MIN_PX_S     (60U)
#define BALL_SPEED_MAX_PX_S     (180U)
#define BALL_ACCEL_PX_S2        (240U)
#define BALL_DECEL_PX_S2        (360U)
#define BALL_BRAKING_ZONE_PX    (96U)

#define GLOW_WIDTH_PX      (48)
#define GLOW_HEIGHT_PX     (8)
#define GLOW_OFFSET_Y_PX   (3)
#define GLOW_PULSE_STEP    (2U)
#define GLOW_OPA_MIN       (40U)
#define GLOW_OPA_MAX       (180U)

#define IMPACT_DURATION_MS (250U)
#define IMPACT_RECOLOR_MAX (180U)


/*****************************************************************************
                     PRIVATE STRUCTS / ENUMS / VARIABLES
*****************************************************************************/
LV_IMAGE_DECLARE(morph_ball);

static lv_obj_t *ball = NULL;
static int32_t ball_x_milli = 0;
static int32_t ball_y = 0;
static int32_t direction = 1;
static int32_t angle_tenths = 0;
static uint32_t previous_ms = 0U;
static int32_t max_x = 0;
static int32_t ball_speed_milli = (int32_t)(BALL_SPEED_MIN_PX_S * MILLI_SCALE);

static lv_obj_t *glow = NULL;
static uint8_t glow_opacity = GLOW_OPA_MIN;
static int32_t glow_direction = 1;

static uint32_t impact_remaining_ms = 0U;


/*****************************************************************************
                         PRIVATE FUNCTION DECLARATIONS
*****************************************************************************/

/*****************************************************************************
                       PRIVATE FUNCTION IMPLEMENTATIONS
*****************************************************************************/
static void on_touch(lv_event_t *event)
{
    ARG_UNUSED(event);
    direction = -direction;
}

static void update_ball_glow(void)
{
    int32_t glow_x = (ball_x_milli / MILLI_SCALE) + ((BALL_SIZE_PX - GLOW_WIDTH_PX) / 2U);
    int32_t glow_y = ball_y + BALL_SIZE_PX - GLOW_OFFSET_Y_PX;

    lv_obj_set_pos(glow, glow_x, glow_y);

    if (0 < glow_direction) {
        if (GLOW_OPA_MAX <= glow_opacity + GLOW_PULSE_STEP) {
            glow_opacity = GLOW_OPA_MAX;
            glow_direction = -1;
        } else {
            glow_opacity += GLOW_PULSE_STEP;
        }
    } else {
        if (GLOW_OPA_MIN >= glow_opacity - GLOW_PULSE_STEP) {
            glow_opacity = GLOW_OPA_MIN;
            glow_direction = 1;
        } else {
            glow_opacity -= GLOW_PULSE_STEP;
        }
    }

    lv_obj_set_style_bg_opa(glow, glow_opacity, 0);
}

static int32_t get_target_speed(void)
{
    int32_t distance_px = 0;
    int32_t target_speed = (int32_t)BALL_SPEED_MAX_PX_S;

    if (0 < direction) {
        distance_px = max_x - (ball_x_milli / (int32_t)MILLI_SCALE);
    } else {
        distance_px = ball_x_milli / (int32_t)MILLI_SCALE;
    }

    if (0 > distance_px) {
        distance_px = 0;
    }

    if ((int32_t)BALL_BRAKING_ZONE_PX > distance_px) {
        target_speed = (int32_t)BALL_SPEED_MIN_PX_S +
                       (((int32_t)(BALL_SPEED_MAX_PX_S - BALL_SPEED_MIN_PX_S) * distance_px) / 
                        (int32_t)BALL_BRAKING_ZONE_PX);
    }

    return target_speed * (int32_t)MILLI_SCALE;
}

static void update_ball_speed(uint32_t delta_ms)
{
    int32_t target_speed = get_target_speed();
    int32_t speed_step = 0;

    if (ball_speed_milli < target_speed) {
        speed_step = (int32_t)(BALL_ACCEL_PX_S2 * delta_ms);

        ball_speed_milli += speed_step;

        if (target_speed < ball_speed_milli) {
            ball_speed_milli = target_speed;
        }
    } else if (ball_speed_milli > target_speed) {
        speed_step = (int32_t)(BALL_DECEL_PX_S2 * delta_ms);

        ball_speed_milli -= speed_step;

        if (target_speed > ball_speed_milli) {
            ball_speed_milli = target_speed;
        }
    }
}

static void trigger_impact(void)
{
    impact_remaining_ms = IMPACT_DURATION_MS;

    lv_obj_set_style_image_recolor_opa(ball, (lv_opa_t)IMPACT_RECOLOR_MAX, 0);
}

static void update_impact_effect(uint32_t delta_ms)
{
    uint32_t opacity = 0U;

    if (0U == impact_remaining_ms) {
        return;
    }

    if (impact_remaining_ms <= delta_ms) {
        impact_remaining_ms = 0U;

        lv_obj_set_style_image_recolor_opa(ball, LV_OPA_TRANSP, 0);

        return;
    }

    impact_remaining_ms -= delta_ms;
    opacity = (IMPACT_RECOLOR_MAX * impact_remaining_ms) / IMPACT_DURATION_MS;

    lv_obj_set_style_image_recolor_opa(ball, (lv_opa_t)opacity, 0);
}

static void animate(lv_timer_t *timer)
{
    ARG_UNUSED(timer);
    performance_animation_record();
    uint32_t now = lv_tick_get();
    uint32_t delta_ms = now - previous_ms;
    previous_ms = now;
    if (MAX_DELTA_MS < delta_ms) {
        delta_ms = MAX_DELTA_MS;
    }

    update_ball_speed(delta_ms);

    int32_t dx_milli = (int32_t)(((int64_t)direction * ball_speed_milli * 
                                  (int32_t)delta_ms) / (int32_t)MILLI_SCALE);
    ball_x_milli += dx_milli;

    if (0 > ball_x_milli) {
        ball_x_milli = -ball_x_milli;
        direction = 1;
        ball_speed_milli = (int32_t)(BALL_SPEED_MIN_PX_S * MILLI_SCALE);
        trigger_impact();
    } else if ((max_x * (int32_t)MILLI_SCALE) < ball_x_milli) {
        ball_x_milli = (2 * max_x * (int32_t)MILLI_SCALE) - ball_x_milli;
        direction = -1;
        ball_speed_milli = (int32_t)(BALL_SPEED_MIN_PX_S * MILLI_SCALE);
        trigger_impact();
    }

    angle_tenths = (int32_t)(((int64_t)ball_x_milli * ANGLE_FULL_TURN) / (BALL_CIRCUMFERENCE_MILLI));
    angle_tenths %= ANGLE_FULL_TURN;
    if (0 > angle_tenths) {
        angle_tenths += ANGLE_FULL_TURN;
    }

    lv_obj_set_pos(ball, (ball_x_milli / (MILLI_SCALE)), ball_y);
    lv_image_set_rotation(ball, angle_tenths);

    update_ball_glow();
    update_impact_effect(delta_ms);
}


/*****************************************************************************
                           INTERFACE IMPLEMENTATION
*****************************************************************************/
int morph_ball_init(lv_obj_t *screen)
{
    if (NULL == screen) {
        return -EINVAL;
    }

    lv_display_t *display = lv_obj_get_display(screen);
    if (NULL == display) {
        return -ENODEV;
    }

    lv_obj_t *title = lv_label_create(screen);
    lv_label_set_text(title, "MORPH BALL");
    lv_obj_set_style_text_color(title, lv_color_hex(SAMUS_YELLOW), 0);
    lv_obj_align(title, LV_ALIGN_TOP_MID, 0, 12);

    lv_obj_t *floor = lv_obj_create(screen);
    lv_obj_set_size(floor, lv_display_get_horizontal_resolution(display), FLOOR_HEIGHT_PX);
    lv_obj_set_pos(floor, 0, lv_display_get_vertical_resolution(display) - FLOOR_OFFSET_PX);
    lv_obj_set_style_bg_color(floor, lv_color_hex(CHOZO_GOLD), 0);
    lv_obj_set_style_border_width(floor, 0, 0);
    lv_obj_set_style_radius(floor, 0, 0);
    lv_obj_set_scrollable(floor, false);

    ball = lv_image_create(screen);
    lv_image_set_src(ball, &morph_ball);
    lv_image_set_pivot(ball, BALL_RADIUS_PX, BALL_RADIUS_PX);
    lv_obj_set_clickable(ball, true);
    lv_obj_add_event_cb(ball, on_touch, LV_EVENT_CLICKED, NULL);
    lv_obj_set_style_image_recolor(ball, lv_color_hex(SAMUS_YELLOW), 0);
    lv_obj_set_style_image_recolor_opa(ball, LV_OPA_TRANSP, 0);

    glow = lv_obj_create(screen);
    lv_obj_set_size(glow, GLOW_WIDTH_PX, GLOW_HEIGHT_PX);
    lv_obj_set_style_bg_color(glow, lv_color_hex(SAMUS_GREEN), 0);
    lv_obj_set_style_bg_opa(glow, glow_opacity, 0);
    lv_obj_set_style_border_width(glow, 0, 0);
    lv_obj_set_style_outline_width(glow, 0, 0);
    lv_obj_set_style_pad_all(glow, 0, 0);
    lv_obj_set_style_radius(glow, LV_RADIUS_CIRCLE, 0);
    lv_obj_set_scrollable(glow, false);
    lv_obj_set_clickable(glow, false);

    return 0;
}

int morph_ball_run(void)
{
    lv_display_t *display = lv_obj_get_display(ball);
    if (NULL == display) {
        return -ENODEV;
    }

    max_x = lv_display_get_horizontal_resolution(display) - BALL_SIZE_PX;
    ball_y = lv_display_get_vertical_resolution(display) - FLOOR_OFFSET_PX - BALL_SIZE_PX;

    ball_x_milli = 0;
    previous_ms = lv_tick_get();

    lv_obj_set_pos(ball, 0, ball_y);

    lv_timer_create(animate, TIMER_PERIOD_MS, NULL);

    LOG_INF("Morph Ball demo started");
    return 0;
}
```

## src/performance.c
```c
/*****************************************************************************
                                    INCLUDES
*****************************************************************************/
#include <errno.h>
#include <stdio.h>
#include <string.h>

#include <zephyr/kernel.h>
#include <zephyr/logging/log.h>
#include <zephyr/sys/atomic.h>

#include <performance.h>
#include <theme.h>


/*****************************************************************************
                          PRIVATE DEFINES / MACROS
*****************************************************************************/
LOG_MODULE_REGISTER(performance, LOG_LEVEL_INF);

#define PERF_REPORT_INTERVAL_MS  (1000U)
#define MS_PER_SECOND            (1000U)

#define PERF_TEXT_SIZE           (32U)
#define PERF_LABEL_X_POS         (-10)
#define PERF_LABEL_Y_POS         (10)


/*****************************************************************************
                     PRIVATE STRUCTS / ENUMS / VARIABLES
*****************************************************************************/
typedef struct {
    uint32_t handler_calls;
    uint64_t handler_total_cycles;
    uint64_t handler_max_cycles;
} perf_stats_t;

static perf_stats_t perf_stats = {0};

static atomic_t frame_count = ATOMIC_INIT(0);
static atomic_t animation_count = ATOMIC_INIT(0);

static lv_obj_t *performance_label = NULL;

static bool print_report = false;
static uint32_t previous_report_ms = 0U;

static uint32_t render_start_cycles = 0U;

static uint64_t render_total_cycles = 0U;
static uint64_t render_max_cycles = 0U;
static uint32_t render_count = 0U;

static uint32_t flush_wait_start_cycles = 0U;
static uint64_t flush_wait_total_cycles = 0U;
static uint64_t flush_wait_max_cycles = 0U;
static uint32_t flush_wait_count = 0U;


/*****************************************************************************
                         PRIVATE FUNCTION DECLARATIONS
*****************************************************************************/

/*****************************************************************************
                       PRIVATE FUNCTION IMPLEMENTATIONS
*****************************************************************************/
static void on_display_refresh(lv_event_t *event)
{
    ARG_UNUSED(event);

    performance_frame_record();
}

static void on_render_start(lv_event_t *event)
{
    ARG_UNUSED(event);

    render_start_cycles = k_cycle_get_32();
}

static void on_render_ready(lv_event_t *event)
{
    uint32_t elapsed_cycles = 0U;

    ARG_UNUSED(event);

    elapsed_cycles = k_cycle_get_32() - render_start_cycles;

    render_total_cycles += (uint64_t)elapsed_cycles;
    render_count++;

    if (render_max_cycles < (uint64_t)elapsed_cycles) {
        render_max_cycles = (uint64_t)elapsed_cycles;
    }
}

static void on_flush_wait_start(lv_event_t *event)
{
    ARG_UNUSED(event);

    flush_wait_start_cycles = k_cycle_get_32();
}

static void on_flush_wait_finish(lv_event_t *event)
{
    uint32_t elapsed_cycles = 0U;

    ARG_UNUSED(event);

    elapsed_cycles = k_cycle_get_32() - flush_wait_start_cycles;

    flush_wait_total_cycles += (uint64_t)elapsed_cycles;
    flush_wait_count++;

    if (flush_wait_max_cycles < (uint64_t)elapsed_cycles) {
        flush_wait_max_cycles = (uint64_t)elapsed_cycles;
    }
}


/*****************************************************************************
                           INTERFACE IMPLEMENTATION
*****************************************************************************/
int performance_init(lv_obj_t *screen, bool enable_print_report)
{
    if (NULL == screen) {
        return -EINVAL;
    }

    lv_display_t *display = lv_obj_get_display(screen);
    if (NULL == display) {
        LOG_ERR("No LVGL display");
        return -ENODEV;
    }

    print_report = enable_print_report;

    memset(&perf_stats, 0, sizeof(perf_stats));

    (void)atomic_set(&frame_count, 0);
    (void)atomic_set(&animation_count, 0);

    previous_report_ms = k_uptime_get_32();

    performance_label = lv_label_create(screen);
    if (NULL == performance_label) {
        return -ENOMEM;
    }

    lv_label_set_text(performance_label, "FPS: --\nAPS: --");
    lv_obj_set_style_text_font(performance_label, &lv_font_montserrat_14, LV_PART_MAIN);
    lv_obj_set_style_text_color(performance_label, lv_color_hex(DARK_SAMUS_BLUE), LV_PART_MAIN);
    lv_obj_set_style_text_align(performance_label, LV_TEXT_ALIGN_RIGHT, LV_PART_MAIN);
    lv_obj_align(performance_label, LV_ALIGN_TOP_RIGHT, PERF_LABEL_X_POS, PERF_LABEL_Y_POS);

    lv_display_add_event_cb(display, on_display_refresh, LV_EVENT_REFR_READY, NULL);
    lv_display_add_event_cb(display, on_render_start, LV_EVENT_RENDER_START, NULL);
    lv_display_add_event_cb(display, on_render_ready, LV_EVENT_RENDER_READY, NULL);
    lv_display_add_event_cb(display, on_flush_wait_start, LV_EVENT_FLUSH_WAIT_START, NULL);
    lv_display_add_event_cb(display, on_flush_wait_finish, LV_EVENT_FLUSH_WAIT_FINISH, NULL);
    return 0;
}

void performance_record_lvgl_handler(uint32_t elapsed_cycles)
{
    perf_stats.handler_calls++;
    perf_stats.handler_total_cycles += (uint64_t)elapsed_cycles;

    if (perf_stats.handler_max_cycles < (uint64_t)elapsed_cycles) {
        perf_stats.handler_max_cycles = (uint64_t)elapsed_cycles;
    }
}

void performance_report(void)
{
    uint32_t now_ms = k_uptime_get_32();
    uint32_t elapsed_ms = now_ms - previous_report_ms;

    uint32_t frames = 0U;
    uint32_t animations = 0U;

    uint32_t fps = 0U;
    uint32_t aps = 0U;

    uint64_t handler_avg_us = 0U;
    uint64_t handler_max_us = 0U;

    uint64_t render_avg_us = 0U;
    uint64_t render_max_us = 0U;

    uint64_t flush_wait_avg_us = 0U;
    uint64_t flush_wait_max_us = 0U;

    char performance_text[PERF_TEXT_SIZE] = {0};

    if (PERF_REPORT_INTERVAL_MS > elapsed_ms) {
        return;
    }

    frames = (uint32_t)atomic_set(&frame_count, 0);
    animations = (uint32_t)atomic_set(&animation_count, 0);

    if (0U < elapsed_ms) {
        fps = (uint32_t)(((uint64_t)frames * MS_PER_SECOND) / elapsed_ms);
        aps = (uint32_t)(((uint64_t)animations * MS_PER_SECOND) / elapsed_ms);
    }

    if (0U < perf_stats.handler_calls) {
        uint64_t handler_avg_cycles = perf_stats.handler_total_cycles / (uint64_t)perf_stats.handler_calls;

        handler_avg_us = k_cyc_to_us_floor64(handler_avg_cycles);
        handler_max_us = k_cyc_to_us_floor64(perf_stats.handler_max_cycles);
    }

    (void)snprintf(performance_text, sizeof(performance_text),
                   "FPS: %u\nAPS: %u", fps, aps);

    if (NULL != performance_label) {
        lv_label_set_text(performance_label, performance_text);
    }

    if (0U < render_count) {
        render_avg_us = k_cyc_to_us_floor64(render_total_cycles / (uint64_t)render_count);
        render_max_us = k_cyc_to_us_floor64(render_max_cycles);
    }

    if (0U < flush_wait_count) {
        flush_wait_avg_us = k_cyc_to_us_floor64(flush_wait_total_cycles / (uint64_t)flush_wait_count);
        flush_wait_max_us = k_cyc_to_us_floor64(flush_wait_max_cycles);
    }

    LOG_INF("FPS: %u | APS: %u | "
            "LVGL avg: %llu us | "
            "Render avg: %llu us | "
            "Flush wait avg: %llu us | Flush wait max: %llu us",
            fps, aps,
            (unsigned long long)handler_avg_us,
            (unsigned long long)render_avg_us,
            (unsigned long long)flush_wait_avg_us,
            (unsigned long long)flush_wait_max_us);

    memset(&perf_stats, 0, sizeof(perf_stats));
    previous_report_ms = now_ms;
    render_total_cycles = 0U;
    render_max_cycles = 0U;
    render_count = 0U;
    flush_wait_total_cycles = 0U;
    flush_wait_max_cycles = 0U;
    flush_wait_count = 0U;
}

void performance_frame_record(void)
{
    (void)atomic_inc(&frame_count);
}

void performance_animation_record(void)
{
    (void)atomic_inc(&animation_count);
}
```

## src/performance.h
```c
/**
 * @file performance.h
 * @brief LVGL performance monitoring and reporting.
 *
 * Provides functions for measuring LVGL handler execution time,
 * tracking rendered frames and animation updates, and displaying
 * performance statistics.
 */

#ifndef PERFORMANCE_H
#define PERFORMANCE_H

/*****************************************************************************
                                    INCLUDES
*****************************************************************************/
#include <stdbool.h>

#include <lvgl.h>


/*****************************************************************************
                       PUBLIC DEFINES / MACROS / ENUMS
*****************************************************************************/

/*****************************************************************************
                         PUBLIC INTERFACE DECLARATION
*****************************************************************************/
/**
 * @brief Initialize the performance monitor.
 *
 * @param[in] screen Parent LVGL object.
 * @param[in] enable_print_report Enable periodic performance logging.
 * 
 * @retval 0 Initialization completed successfully.
 * @retval -EINVAL Invalid screen pointer.
 * @retval -ENOMEM Failed to create the performance label.
 */
int performance_init(lv_obj_t *screen, bool enable_print_report);

/**
 * @brief Record LVGL timer handler execution time.
 *
 * @param[in] elapsed_cycles Number of CPU cycles spent in the handler.
 */
void performance_record_lvgl_handler(uint32_t elapsed_cycles);

/**
 * @brief Update and optionally log performance statistics.
 */
void performance_report(void);

/**
 * @brief Record a completed display frame.
 */
void performance_frame_record(void);

/**
 * @brief Record an animation update.
 */
void performance_animation_record(void);

#endif // PERFORMANCE_H
```

## src/theme.h
```c
/**
 * @file theme.h
 * @brief Color definitions for the application user interface.
 */

#ifndef THEME_H
#define THEME_H

#define SAMUS_VARIA_ORANGE  (0xF07818U)
#define SAMUS_YELLOW        (0xFFAA42U)
#define SAMUS_RED       	(0xD62828U)
#define SAMUS_BLUE      	(0x2389DAU)
#define SAMUS_GREEN     	(0x50C878U)
#define SAMUS_PURPLE    	(0x8445C7U)

#define DARK_SAMUS_BLUE     (0x00CFFFU)
#define DARK_SAMUS_ARMOR	(0x142B5AU)

#define CHOZO_DARK_BLUE     (0x07101BU)
#define CHOZO_GOLD          (0xB89B5EU)

#endif // THEME_H
```
