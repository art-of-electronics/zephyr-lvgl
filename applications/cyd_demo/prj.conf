## CMakeLists.txt
```
cmake_minimum_required(VERSION 3.20.0)

set(EXTRA_ZEPHYR_MODULES
    "${CMAKE_CURRENT_SOURCE_DIR}/../.."
)

# CYD LCD orientation
set(CYD_BOARD_DIR
    "${CMAKE_CURRENT_SOURCE_DIR}/../../boards/cyd/esp32_035"
)

set(CYD_LCD_ROTATION 0)

set(CYD_ROTATION_CONF
    "${CMAKE_CURRENT_SOURCE_DIR}/prj.conf"
)

set_property(
    DIRECTORY APPEND PROPERTY CMAKE_CONFIGURE_DEPENDS
    "${CYD_ROTATION_CONF}"
)

file(
    STRINGS
    "${CYD_ROTATION_CONF}"
    CYD_ROTATION_CONFIG
    REGEX "^CONFIG_CYD_LCD_ROTATION_(0|90|180|270)=y[ \t]*$"
)

list(LENGTH CYD_ROTATION_CONFIG CYD_ROTATION_COUNT)

if(CYD_ROTATION_COUNT GREATER 1)
    message(FATAL_ERROR
        "Multiple CYD LCD orientations selected"
    )
elseif(CYD_ROTATION_COUNT EQUAL 1)
    string(
        REGEX REPLACE
        "^CONFIG_CYD_LCD_ROTATION_([0-9]+)=y[ \t]*$"
        "\\1"
        CYD_LCD_ROTATION
        "${CYD_ROTATION_CONFIG}"
    )
endif()

message(STATUS
    "CYD LCD rotation: ${CYD_LCD_ROTATION} degrees"
)

configure_file(
    "${CYD_BOARD_DIR}/cyd_rotation.overlay.in"
    "${CMAKE_CURRENT_BINARY_DIR}/cyd_rotation.overlay"
    @ONLY
)

list(
    APPEND EXTRA_DTC_OVERLAY_FILE
    "${CMAKE_CURRENT_BINARY_DIR}/cyd_rotation.overlay"
)

find_package(Zephyr REQUIRED HINTS $ENV{ZEPHYR_BASE})
project(cyd_demo)

target_include_directories(app PRIVATE src)

target_sources(app PRIVATE 
    src/main.c
    src/demo_rgb.c
    src/demo_lcd.c
    #src/demo_touch.c
)

set(external_project_cflags
    "${includes} ${definitions} ${options} ${system_includes} -DDISABLE_AUTOMATIC_FW_UPDATE"
)
```

## prj.conf
```kconfig
# System logging
CONFIG_LOG=y

# Hardware peripherals
CONFIG_GPIO=y
CONFIG_PWM=y
CONFIG_SPI=y
CONFIG_ADC=y

# LCD display
CONFIG_CYD_ST7796S_PANEL_INIT=y
CONFIG_DISPLAY=y
CONFIG_MIPI_DBI=y
CONFIG_CYD_LCD_ROTATION_0=y
# CONFIG_CYD_LCD_ROTATION_90=y
# CONFIG_CYD_LCD_ROTATION_180=y
# CONFIG_CYD_LCD_ROTATION_270=y

# XPT2046 touchscreen
CONFIG_INPUT=y
CONFIG_INPUT_XPT2046=y

# LVGL
CONFIG_LVGL=y
CONFIG_LV_COLOR_FORMAT_RGB565=y
CONFIG_LV_Z_MEM_POOL_SIZE=65536
CONFIG_LV_Z_PARTIAL_REFRESH=y
CONFIG_LV_Z_VDB_SIZE=10
CONFIG_LV_Z_BUFFER_ALLOC_STATIC=y
CONFIG_LV_Z_AUTO_INIT=y
CONFIG_LV_Z_POINTER_FROM_CHOSEN_TOUCH=y

# LVGL fonts
CONFIG_LV_FONT_MONTSERRAT_20=y
CONFIG_LV_FONT_MONTSERRAT_28=y
CONFIG_LV_FONT_MONTSERRAT_40=y
```

## src/main.c
```c
#include <errno.h>
#include <stdbool.h>
#include <stdint.h>

#include <demo_rgb.h>
#include <demo_lcd.h>

#include <zephyr/kernel.h>
#include <zephyr/drivers/adc.h>
#include <zephyr/logging/log.h>

LOG_MODULE_REGISTER(cyd_demo, LOG_LEVEL_INF);

#define LDR_NODE DT_PATH(zephyr_user)

static const struct adc_dt_spec ldr_adc = ADC_DT_SPEC_GET(LDR_NODE);;

static struct k_thread demo_rgb_thread_data = {0};
static struct k_thread demo_lcd_thread_data = {0};

K_THREAD_STACK_DEFINE(demo_rgb_stack, THREAD_DEMO_RGB_STACK_SIZE);
K_THREAD_STACK_DEFINE(demo_lcd_stack, THREAD_DEMO_LCD_STACK_SIZE);

static void demo_rgb_task(void *arg1, void*arg2, void *arg3) {
    (void)arg1;
    (void)arg2;
    (void)arg3;

    int ret = 0;

    ret = demo_rgb_init();
    if (0 != ret) {
        LOG_ERR("RGB Led init() fail %d", ret);
        return;
    }

    ret = demo_rgb_set_rgb(0U, 0U, 0U);
    if (0 != ret) {
        LOG_ERR("RGB Led set_rgb() fail %d", ret);
        return;
    }

    while (1) {
        demo_rgb_loop();
    }
}

static void demo_lcd_task(void *arg1, void*arg2, void *arg3) {
    (void)arg1;
    (void)arg2;
    (void)arg3;

    int ret = 0;

    ret = demo_lcd_pwm_init();
    if (0 != ret) {
        LOG_ERR("LCD pwm_init() fail %d", ret);
        return;
    }

    ret = demo_lcd_set_brightness(35U);
    if (0 != ret) {
        LOG_ERR("LCD set_brightness() fail %d", ret);
        return;
    }

    ret = demo_lcd_init_lcd();
    if (0 != ret) {
        LOG_ERR("LCD init() fail %d", ret);
        return;
    }

    while (1) {
        demo_lcd_loop();
    }
}

int demo_rgb_start(void) {
	k_tid_t tid;

	tid = k_thread_create(&demo_rgb_thread_data, demo_rgb_stack,
			              K_THREAD_STACK_SIZEOF(demo_rgb_stack), demo_rgb_task, 
                          NULL, NULL, NULL, THREAD_DEMO_RGB_PRIORITY, 0, K_NO_WAIT);

	if (NULL == tid) {
		return -EIO;
	}

	k_thread_name_set(tid, "demo_rgb");

	return 0;
}

int demo_lcd_start(void) {
	k_tid_t tid;

	tid = k_thread_create(&demo_lcd_thread_data, demo_lcd_stack,
			              K_THREAD_STACK_SIZEOF(demo_lcd_stack), demo_lcd_task, 
                          NULL, NULL, NULL, THREAD_DEMO_LCD_PRIORITY, 0, K_NO_WAIT);

	if (NULL == tid) {
		return -EIO;
	}

	k_thread_name_set(tid, "demo_lcd");

	return 0;
}


int main(void)
{
    int ret = 0;
    int16_t sample = 0;
    struct adc_sequence sequence = {0};

    if (false == adc_is_ready_dt(&ldr_adc)) {
        LOG_ERR("LDR ADC device is not ready");
        return -ENODEV;
    }

    ret = adc_channel_setup_dt(&ldr_adc);
    if (0 != ret) {
        LOG_ERR("LDR ADC channel setup failed: %d", ret);
        return ret;
    }

    sequence.buffer = &sample;
    sequence.buffer_size = sizeof(sample);

    ret = adc_sequence_init_dt(&ldr_adc, &sequence);
    if (0 != ret) {
        LOG_ERR("LDR ADC sequence init failed: %d", ret);
        return ret;
    }

    (void)demo_rgb_start();
    (void)demo_lcd_start();

    while (true) {
        sample = 0;

        ret = adc_read_dt(&ldr_adc, &sequence);
        if (0 == ret) {
            int32_t voltage_mv = (int32_t)sample;

            ret = adc_raw_to_millivolts_dt(&ldr_adc, &voltage_mv);
            if (0 == ret) {
                LOG_INF("LDR: raw=%d, voltage=%ld mV", (int)sample, (long)voltage_mv);
            } else {
                LOG_ERR("LDR voltage conversion failed: %d", ret);
            }
        } else {
            LOG_ERR("LDR ADC read failed: %d", ret);
        }
        
        k_sleep(K_SECONDS(1));
    }
}
```

## src/demo_lcd.c
```c
#include <demo_lcd.h>
#include <cyd_st7796s.h>

#include <zephyr/kernel.h>
#include <zephyr/device.h>
#include <zephyr/drivers/pwm.h>
#include <zephyr/drivers/display.h>
#include <zephyr/sys/byteorder.h>
#include <zephyr/logging/log.h>
#include <zephyr/version.h>

#include <lvgl.h>

LOG_MODULE_REGISTER(demo_lcd, LOG_LEVEL_INF);

#define LCD_BACKLIGHT_NODE  DT_ALIAS(backlight)

#define PWM_BACKLIGHT_MIN   (10U)
#define PWM_MAX_BRIGHTNESS  (100U)

#define LVGL_TASK_DELAY_MS  (10U)

#define VERSION_TEXT_SIZE	    (64U)
#define ANIMATION_DURATION_MS 	(3000U)
#define ANIMATION_BOX_SIZE    	(60)

#define SAMUS_ORANGE		(0xF28C28U)
#define SAMUS_RED       	(0xD62828U)
#define SAMUS_BLUE      	(0x2389DAU)
#define SAMUS_GREEN     	(0x50C878U)
#define SAMUS_PURPLE    	(0x8445C7U)
#define DARK_SAMUS_BLUE     (0x00CFFFU)
#define DARK_SAMUS_ARMOR	(0x142B5AU)

static lv_obj_t *screen = NULL;
static lv_obj_t *counter_label = NULL;
static uint32_t click_count = 0U;

static const struct pwm_dt_spec lcd_backlight = PWM_DT_SPEC_GET(LCD_BACKLIGHT_NODE);
static const struct device *display = DEVICE_DT_GET(DT_CHOSEN(zephyr_display));

static int pwm_set_brightness(const struct pwm_dt_spec *pwm, uint32_t brightness)
{
    uint64_t pulse = 0U;

    if (PWM_MAX_BRIGHTNESS < brightness) {
        return -EINVAL;
    }

    pulse = ((uint64_t)pwm->period * brightness) / PWM_MAX_BRIGHTNESS;

    return pwm_set_dt(pwm, pwm->period, (uint32_t)pulse);
}

int demo_lcd_pwm_init(void)
{
    if (true != pwm_is_ready_dt(&lcd_backlight)) {
        LOG_ERR("PWM controller not ready");
        return -ENODEV;
    }

    return 0;
}

int demo_lcd_set_brightness(uint32_t brightness) 
{
    int ret = pwm_set_brightness(&lcd_backlight, brightness);
    if (0 != ret) {
        LOG_ERR("Backlight PWM failed: %d", ret);
        return ret;
    }

    return 0;
}

static void clickme_button_event_cb(lv_event_t *event)
{
    if (LV_EVENT_CLICKED == lv_event_get_code(event)) {
        click_count++;
		lv_label_set_text_fmt(counter_label, "Clicks: %u", click_count);

        LOG_INF("Button clicked: %u", (unsigned int)click_count);
    }
}

static void create_clickme(lv_obj_t *screen)
{
    lv_obj_t *button = NULL;
    lv_obj_t *button_label = NULL;

	lv_display_t *display = lv_obj_get_display(screen);
	int32_t screen_width = lv_display_get_horizontal_resolution(display);
	int32_t screen_height = lv_display_get_vertical_resolution(display);
	
    counter_label = lv_label_create(screen);
    lv_label_set_text(counter_label, "Clicks: 0");
	lv_obj_set_style_text_font(counter_label, &lv_font_montserrat_28, LV_PART_MAIN);
    lv_obj_set_style_text_color(counter_label, lv_color_hex(SAMUS_PURPLE), LV_PART_MAIN);
    lv_obj_align(counter_label, LV_ALIGN_TOP_LEFT, 20, 20);

	button = lv_obj_create(screen);
	lv_obj_set_size(button, 160, 50);
	if (screen_height > screen_width) {
		lv_obj_align(button, LV_ALIGN_TOP_RIGHT, -20, 60);
	} else {
		lv_obj_align(button, LV_ALIGN_TOP_RIGHT, -20, 20);
	}
	lv_obj_set_scrollable(button, false);
	lv_obj_set_clickable(button, true);

	lv_obj_set_style_bg_color(button, lv_color_hex(SAMUS_ORANGE), LV_PART_MAIN);
	lv_obj_set_style_bg_color(button, lv_color_hex(DARK_SAMUS_ARMOR), LV_PART_MAIN | LV_STATE_PRESSED);
	lv_obj_set_style_bg_opa(button, LV_OPA_COVER, LV_PART_MAIN);
	lv_obj_set_style_border_width(button, 0, LV_PART_MAIN);
	lv_obj_set_style_radius(button, 10, LV_PART_MAIN);
	lv_obj_set_style_shadow_width(button, 0, LV_PART_MAIN);

	lv_obj_set_style_text_color(button, lv_color_hex(DARK_SAMUS_ARMOR), LV_PART_MAIN);
	lv_obj_set_style_text_color(button, lv_color_hex(DARK_SAMUS_BLUE), LV_PART_MAIN | LV_STATE_PRESSED);
	lv_obj_add_event_cb(button, clickme_button_event_cb, LV_EVENT_CLICKED, NULL);

	button_label = lv_label_create(button);
	lv_label_set_text(button_label, "CLICK ME!");
	lv_obj_set_style_text_font(button_label, &lv_font_montserrat_28, LV_PART_MAIN);
	lv_obj_center(button_label);
}

static void morphball_animation_cb(void *obj, int32_t value)
{
    lv_obj_set_x((lv_obj_t *)obj, value);
}

static void create_morphball_anim(lv_obj_t *screen)
{
	static lv_obj_t *morph_ball = NULL;
	static lv_anim_t anim;

	lv_display_t *display = lv_obj_get_display(screen);
	int32_t screen_width = lv_display_get_horizontal_resolution(display);
	int32_t screen_height = lv_display_get_vertical_resolution(display);

	int32_t animation_start_x = 0;
	int32_t animation_end_x = screen_width - ANIMATION_BOX_SIZE;
	int32_t animation_y = screen_height - 130U;

	morph_ball = lv_obj_create(screen);

	lv_obj_set_size(morph_ball, ANIMATION_BOX_SIZE, ANIMATION_BOX_SIZE);
	lv_obj_set_style_bg_color(morph_ball, lv_color_hex(SAMUS_ORANGE), LV_PART_MAIN);
	lv_obj_set_style_bg_opa(morph_ball, LV_OPA_COVER, LV_PART_MAIN);
	lv_obj_set_style_radius(morph_ball, (ANIMATION_BOX_SIZE / 2U), LV_PART_MAIN);
	lv_obj_set_style_border_width(morph_ball, 0, LV_PART_MAIN);

	lv_obj_set_pos(morph_ball, animation_start_x, animation_y);

	lv_anim_init(&anim);
	lv_anim_set_var(&anim, morph_ball);
	lv_anim_set_exec_cb(&anim, morphball_animation_cb);
	lv_anim_set_values(&anim, animation_start_x, animation_end_x);
	lv_anim_set_duration(&anim, ANIMATION_DURATION_MS);
	lv_anim_set_playback_duration(&anim, ANIMATION_DURATION_MS);
	lv_anim_set_repeat_count(&anim, LV_ANIM_REPEAT_INFINITE);
	lv_anim_start(&anim);
}

static void create_main_screen(lv_obj_t *screen, bool gradient_bg)
{
	if(true == gradient_bg) {
		lv_obj_set_style_bg_color(screen, lv_color_hex(DARK_SAMUS_BLUE), LV_PART_MAIN);
		lv_obj_set_style_bg_grad_color(screen, lv_color_hex(DARK_SAMUS_ARMOR),LV_PART_MAIN);
		lv_obj_set_style_bg_grad_dir(screen, LV_GRAD_DIR_VER, LV_PART_MAIN);
		lv_obj_set_style_bg_opa(screen, LV_OPA_COVER, LV_PART_MAIN);
	} else {
		lv_obj_set_style_bg_color(screen, lv_color_hex(DARK_SAMUS_ARMOR), LV_PART_MAIN);
    	lv_obj_set_style_bg_opa(screen, LV_OPA_COVER, LV_PART_MAIN);
	}
}

static void create_version(lv_obj_t *screen, bool show_signature)
{
	static lv_obj_t *version_label = NULL;
	static lv_obj_t *label = NULL;
	char version_text[VERSION_TEXT_SIZE] = {0};

	lv_display_t *display = lv_obj_get_display(screen);
	int32_t screen_width = lv_display_get_horizontal_resolution(display);
	int32_t screen_height = lv_display_get_vertical_resolution(display);

	if (screen_height > screen_width) {
		(void)snprintf(version_text, sizeof(version_text),
			       "Zephyr %u.%u\nLVGL %u.%u",
			       (unsigned int)KERNEL_VERSION_MAJOR,
			       (unsigned int)KERNEL_VERSION_MINOR,
			       (unsigned int)lv_version_major(),
			       (unsigned int)lv_version_minor());
	} else {
		(void)snprintf(version_text, sizeof(version_text),
			       "Zephyr %u.%u x LVGL %u.%u",
			       (unsigned int)KERNEL_VERSION_MAJOR,
			       (unsigned int)KERNEL_VERSION_MINOR,
			       (unsigned int)lv_version_major(),
			       (unsigned int)lv_version_minor());
	}

	version_label = lv_label_create(screen);
	lv_label_set_text(version_label, version_text);
	lv_obj_set_style_text_font(version_label, &lv_font_montserrat_40, LV_PART_MAIN);
	lv_obj_set_style_text_color(version_label, lv_color_hex(SAMUS_ORANGE), LV_PART_MAIN);
	lv_obj_set_style_text_align(version_label, LV_TEXT_ALIGN_CENTER, LV_PART_MAIN);
	lv_obj_center(version_label);

	if (true == show_signature) {
		label = lv_label_create(screen);
		lv_label_set_text(label, "@_art_of_electronics_");
		lv_obj_set_style_text_font(label, &lv_font_montserrat_28, LV_PART_MAIN);
		lv_obj_set_style_text_color(label, lv_color_hex(SAMUS_RED), LV_PART_MAIN);
		lv_obj_align(label, LV_ALIGN_BOTTOM_MID, 0, -20);
	}
}

int demo_lcd_init_lcd(void)
{
    int ret = 0;

    struct display_capabilities capabilities = {0};
    if (true != device_is_ready(display)) {
        LOG_ERR("Display device not ready");
        return -ENODEV;
    }

    display_get_capabilities(display, &capabilities);

    LOG_INF("Display device: %s", display->name);
    LOG_INF("Display: %u x %u", capabilities.x_resolution, capabilities.y_resolution);
    LOG_INF("Pixel format: 0x%x", capabilities.current_pixel_format);

    ret = cyd_st7796s_configure();
    if (0 != ret) {
        LOG_ERR("LCD configuration failed: %d", ret);
        return ret;
    }

    ret = display_blanking_off(display);
    if (0 != ret) {
        LOG_ERR("Display blanking off failed: %d", ret);
        return ret;
    }

    screen = lv_screen_active();
	if (NULL == screen) {
    	LOG_ERR("LVGL active screen is NULL");
    	return -ENODEV;
	}

	LOG_INF("LCD RGB started");

    create_main_screen(screen, true);
	create_version(screen, true);
    create_morphball_anim(screen);
    create_clickme(screen);

    return 0;
}

void demo_lcd_loop(void) 
{
    (void)lv_timer_handler();

    k_msleep(LVGL_TASK_DELAY_MS);
}
```

## src/demo_lcd.h
```c
#ifndef DEMO_LCD_H
#define DEMO_LCD_H

#include <stdint.h>

#define THREAD_DEMO_LCD_STACK_SIZE  (8192)
#define THREAD_DEMO_LCD_PRIORITY    (5)

int demo_lcd_pwm_init(void);

int demo_lcd_set_brightness(uint32_t brightness);

int demo_lcd_init_lcd(void);

void demo_lcd_loop(void);

#endif //DEMO_LCD_H
```

## src/demo_rgb.c
```c
#include <demo_rgb.h>

#include <zephyr/kernel.h>
#include <zephyr/device.h>
#include <zephyr/drivers/pwm.h>
#include <zephyr/logging/log.h>

LOG_MODULE_REGISTER(demo_rgb, LOG_LEVEL_INF);

#define LED_RED_NODE        DT_ALIAS(led0)
#define LED_GREEN_NODE      DT_ALIAS(led1)
#define LED_BLUE_NODE       DT_ALIAS(led2)

#define PWM_MAX_BRIGHTNESS  (100U)
#define PWM_STEP_DELAY_MS   (20U)
#define PWM_COLOR_STEPS     (100U)

static const struct pwm_dt_spec led_red = PWM_DT_SPEC_GET(LED_RED_NODE);
static const struct pwm_dt_spec led_green = PWM_DT_SPEC_GET(LED_GREEN_NODE);
static const struct pwm_dt_spec led_blue = PWM_DT_SPEC_GET(LED_BLUE_NODE);

static int pwm_set_brightness(const struct pwm_dt_spec *pwm, uint32_t brightness)
{
    uint64_t pulse = 0U;

    if (PWM_MAX_BRIGHTNESS < brightness) {
        return -EINVAL;
    }

    pulse = ((uint64_t)pwm->period * brightness) / PWM_MAX_BRIGHTNESS;

    return pwm_set_dt(pwm, pwm->period, (uint32_t)pulse);
}

static int pwm_set_rgb(uint32_t red, uint32_t green, uint32_t blue)
{
    int ret = 0;

    ret = pwm_set_brightness(&led_red, red);
    if (0 != ret) {
        return ret;
    }

    ret = pwm_set_brightness(&led_green, green);
    if (0 != ret) {
        return ret;
    }

    ret = pwm_set_brightness(&led_blue, blue);
    if (0 != ret) {
        return ret;
    }

    return 0;
}

int demo_rgb_init(void)
{
    if ((true != pwm_is_ready_dt(&led_red)) ||
        (true != pwm_is_ready_dt(&led_green)) ||
        (true != pwm_is_ready_dt(&led_blue))) {
            LOG_ERR("PWM controller not ready");
            return -ENODEV;
    }

    LOG_INF("RGB Led init() successfull");

    return 0;
}

int demo_rgb_set_rgb(uint32_t red, uint32_t green, uint32_t blue)
{
    int ret = pwm_set_rgb(red, green, blue);
    if (0 != ret) {
        LOG_ERR("RGB PWM failed: %d", ret);
        return ret;
    }

    return 0;
}

void demo_rgb_loop(void) 
{
    uint32_t step = 0U;

    for (step = 0U; step <= PWM_COLOR_STEPS; step++) {
        (void)demo_rgb_set_rgb(PWM_COLOR_STEPS - step, step, 0U);
        k_msleep(PWM_STEP_DELAY_MS);
    }

    for (step = 0U; step <= PWM_COLOR_STEPS; step++) {
        (void)demo_rgb_set_rgb(0U, PWM_COLOR_STEPS - step, step);
        k_msleep(PWM_STEP_DELAY_MS);
    }

    for (step = 0U; step <= PWM_COLOR_STEPS; step++) {
        (void)demo_rgb_set_rgb(step, 0U, PWM_COLOR_STEPS - step);
        k_msleep(PWM_STEP_DELAY_MS);
    }
}
```

## src/demo_rgb.h
```c
#ifndef DEMO_RGB_H
#define DEMO_RGB_H

#include <stdint.h>

#define THREAD_DEMO_RGB_STACK_SIZE  (512)
#define THREAD_DEMO_RGB_PRIORITY    (5)

int demo_rgb_init(void);

int demo_rgb_set_rgb(uint32_t red, uint32_t green, uint32_t blue);

void demo_rgb_loop(void);

#endif //DEMO_RGB_H
```

## src/demo_touch.c
```c
#include <demo_touch.h>

#include <errno.h>
#include <zephyr/kernel.h>
#include <zephyr/device.h>
#include <zephyr/devicetree.h>
#include <zephyr/input/input.h>
#include <zephyr/logging/log.h>

LOG_MODULE_REGISTER(demo_touch, LOG_LEVEL_INF);

#define TOUCH_NODE DT_NODELABEL(touchscreen)

static const struct device *const touch_dev = DEVICE_DT_GET(TOUCH_NODE);

static void touch_callback(struct input_event *event, void *user_data)
{
    ARG_UNUSED(user_data);

    if (INPUT_ABS_X == event->code) {
        LOG_INF("Touch X: %d", event->value);
    } else if (INPUT_ABS_Y == event->code) {
        LOG_INF("Touch Y: %d", event->value);
    } else if (INPUT_BTN_TOUCH == event->code) {
        LOG_INF("Touch: %s", (0 != event->value) ? "PRESSED" : "RELEASED");
    }
}

INPUT_CALLBACK_DEFINE(DEVICE_DT_GET(TOUCH_NODE), touch_callback, NULL);

int demo_touch_init(void)
{
    if (false == device_is_ready(touch_dev)) {
        LOG_ERR("XPT2046 device not ready");
        return -ENODEV;
    }

    LOG_INF("XPT2046 ready");

    return 0;
}
```

## src/demo_touch.h
```c
#ifndef DEMO_TOUCH_H
#define DEMO_TOUCH_H

int demo_touch_init(void);

#endif //DEMO_TOUCH_H
```
